## project-spec/meta-user/conf/layer.conf
```bitbake
# We have a conf and classes directory, add to BBPATH
BBPATH .= ":${LAYERDIR}"

# We have recipes-* directories, add to BBFILES
BBFILES += "${LAYERDIR}/recipes-*/*/*.bb \
	${LAYERDIR}/recipes-*/*/*.bbappend"

# Define dynamic layers
BBFILES_DYNAMIC += " \
xilinx-tools:${LAYERDIR}/meta-xilinx-tools/recipes-*/*/*.bbappend \
"

BBFILE_COLLECTIONS += "meta-user"
BBFILE_PATTERN_meta-user = "^${LAYERDIR}/"
BBFILE_PRIORITY_meta-user = "7"
LAYERSERIES_COMPAT_meta-user = "scarthgap"

IMAGE_INSTALL:append = " nano cmake tmux alsa-utils packagegroup-core-buildessential"

IMAGE_INSTALL:append = " mdac gmrender-resurrect libupnp-dev"

#IMAGE_INSTALL:append = " spotifyd"
#IMAGE_INSTALL:append = " librespot"

#IMAGE_INSTALL:append = " gstreamer1.0 gstreamer1.0-plugins-base gstreamer1.0-plugins-base-alsa gstreamer1.0-plugins-good gstreamer1.0-plugins-good-alsa"
#IMAGE_INSTALL:append = " pulseaudio pulseaudio-server pulseaudio-utils pulseaudio-module-cli-protocol-unix pulseaudio-module-alsa pulseaudio-module-native-protocol-unix "
```
